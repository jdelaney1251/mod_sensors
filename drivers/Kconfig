## drivers/adc/Kconfig.mcp3424
```kconfig
# MCP3424 I2C ADC configuation options

config ADC_MCP3424
    bool "MCP3424 driver"
    depends on I2C

#if ADC_MCP3424

config ADC_MCP3424_INIT_PRIORITY
	int "Init priority"
	default 80
	help
	  MCP3424 ADC device driver initialization priority.

config ADC_MCP3424_ACQUISITION_THREAD_STACK_SIZE
	int "stack size"
	default 512
	help
		Size of the stack used for data acquisition thread.

config ADC_MCP3424_ACQUISITION_THREAD_PRIO
	int "acquisition thread priority"
	default 0
	help
		Data acquisition thread priority
#endif # ADC_MCP320X
```

## drivers/dcmi/Kconfig
```kconfig
config SW_DCMI
    bool "enable SW_DCMI interface driver"

if SW_DCMI

module = SW_DCMI
module-str = sw_dcmi
source "subsys/logging/Kconfig.template.log_config"

endif
```

## drivers/sensor/Kconfig
```kconfig
# Copyright (c) 2021 Nordic Semiconductor ASA
# SPDX-License-Identifier: Apache-2.0

rsource "bh1750/Kconfig"
rsource "spw2430/Kconfig"
```

## drivers/sensor/bh1750/Kconfig
```kconfig
# Copyright (c) 2019 Nordic Semiconductor
# SPDX-License-Identifier: Apache-2.0

config BH1750
	bool "Enable support for the demonstration out of tree driver"

config BH1750_MODE_CONT
	bool "continuous measurement mode"

config BH1750_MODE_SINGLE
	bool "single measurement mode"	

config BH1750_0_5lx_RES
	bool "0.5lx resolution measurements"

config BH1750_1lx_RES
	bool "1lx resolution measurements"
	
config BH1750_4lx_RES
	bool "4lx resolution measurements"
	
```

## drivers/sensor/spw2430/Kconfig
```kconfig
# Copyright (c) 2019 Nordic Semiconductor
# SPDX-License-Identifier: Apache-2.0

config SPW2430
	bool "Enable support for the demonstration out of tree driver"


	
```

## drivers/video/Kconfig
```kconfig
config SPI_CAM
    bool "enable Arducam Mini SPI camera driver"

if SPI_CAM

config ARDUCAM_SPI_INIT_PRIORITY
	int "Init priority"
	default 80
	help
	  Arducam SPI camera device driver initialization priority.

module = SPI_CAM
module-str = spi_cam
source "subsys/logging/Kconfig.template.log_config"

endif
```

## dts/bindings/adc/microchip,mcp3424.yaml
```yaml
description: MCP3424 4-channel I2C ADC



include: [adc-controller.yaml, i2c-device.yaml]

properties:
    "#io-channel-cells":
      const: 1

io-channel-cells:
    - channel

compatible: "microchip,mcp3424"
```

## dts/bindings/sensor/knowles,spw2430.yaml
```yaml
description: SPW2430 MEMS microphone

compatible: "knowles,spw2430"

properties:
  label:
    type: string
    required: true
  io-channels:
    type: phandle-array
    required: true
```

## dts/bindings/sensor/rohm,bh1750-i2c.yaml
```yaml
description: BH1750 light sensor

compatible: "rohm,bh1750"

include: i2c-device.yaml
```

## dts/bindings/sw_dcmi/sw-dcmi.yaml
```yaml
description: |
    Hardware configuration/pin assignments for an stm32 dcmi-like interface for parallel cameras


compatible: "sw-dcmi"

include: base.yaml

properties:
    pclk_io:
      required: true
      type: phandle-array
    href_io:
      required: true
      type: phandle-array
    vsync_io:
      required: true
      type: phandle-array
    data_port:
      required: true
      type: phandle-array
      description: |
            phandle for the desired GPIO port and either the upper or lower portion of the port
            all pins must be 8 sequential pins in the chosen GPIO port
            e.g. <&gpiob 0> means the lower 8 bits of GPIOB (<&gpiob 1> would be bits 8-15)
    pwdn_io:
      required: true
      type: phandle-array
    rst_io:
      required: true
      type: phandle-array
      
```

## dts/bindings/video/arducam,spi-cam.yaml
```yaml
description: |
    Hardware configuration/pin assignments for an stm32 dcmi-like interface for parallel cameras


compatible: "arducam,spi-cam"

include: spi-device.yaml
```
